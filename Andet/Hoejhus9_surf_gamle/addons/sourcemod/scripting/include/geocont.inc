#if defined _geocont_included
#endinput
#endif
#define _geocont_included

new Handle:g_hCountries = INVALID_HANDLE;

stock GeoStart()
{
	g_hCountries = CreateTrie();
	SetTrieString(g_hCountries, "A1", "--");
	SetTrieString(g_hCountries, "A2", "--");
	SetTrieString(g_hCountries, "AD", "EU");
	SetTrieString(g_hCountries, "AE", "AS");
	SetTrieString(g_hCountries, "AF", "AS");
	SetTrieString(g_hCountries, "AG", "NA");
	SetTrieString(g_hCountries, "AI", "NA");
	SetTrieString(g_hCountries, "AL", "EU");
	SetTrieString(g_hCountries, "AM", "AS");
	SetTrieString(g_hCountries, "AN", "NA");
	SetTrieString(g_hCountries, "AO", "AF");
	SetTrieString(g_hCountries, "AP", "AS");
	SetTrieString(g_hCountries, "AQ", "AN");
	SetTrieString(g_hCountries, "AR", "SA");
	SetTrieString(g_hCountries, "AS", "OC");
	SetTrieString(g_hCountries, "AT", "EU");
	SetTrieString(g_hCountries, "AU", "OC");
	SetTrieString(g_hCountries, "AW", "NA");
	SetTrieString(g_hCountries, "AX", "EU");
	SetTrieString(g_hCountries, "AZ", "AS");
	SetTrieString(g_hCountries, "BA", "EU");
	SetTrieString(g_hCountries, "BB", "NA");
	SetTrieString(g_hCountries, "BD", "AS");
	SetTrieString(g_hCountries, "BE", "EU");
	SetTrieString(g_hCountries, "BF", "AF");
	SetTrieString(g_hCountries, "BG", "EU");
	SetTrieString(g_hCountries, "BH", "AS");
	SetTrieString(g_hCountries, "BI", "AF");
	SetTrieString(g_hCountries, "BJ", "AF");
	SetTrieString(g_hCountries, "BL", "NA");
	SetTrieString(g_hCountries, "BM", "NA");
	SetTrieString(g_hCountries, "BN", "AS");
	SetTrieString(g_hCountries, "BO", "SA");
	SetTrieString(g_hCountries, "BR", "SA");
	SetTrieString(g_hCountries, "BS", "NA");
	SetTrieString(g_hCountries, "BT", "AS");
	SetTrieString(g_hCountries, "BV", "AN");
	SetTrieString(g_hCountries, "BW", "AF");
	SetTrieString(g_hCountries, "BY", "EU");
	SetTrieString(g_hCountries, "BZ", "NA");
	SetTrieString(g_hCountries, "CA", "NA");
	SetTrieString(g_hCountries, "CC", "AS");
	SetTrieString(g_hCountries, "CD", "AF");
	SetTrieString(g_hCountries, "CF", "AF");
	SetTrieString(g_hCountries, "CG", "AF");
	SetTrieString(g_hCountries, "CH", "EU");
	SetTrieString(g_hCountries, "CI", "AF");
	SetTrieString(g_hCountries, "CK", "OC");
	SetTrieString(g_hCountries, "CL", "SA");
	SetTrieString(g_hCountries, "CM", "AF");
	SetTrieString(g_hCountries, "CN", "AS");
	SetTrieString(g_hCountries, "CO", "SA");
	SetTrieString(g_hCountries, "CR", "NA");
	SetTrieString(g_hCountries, "CU", "NA");
	SetTrieString(g_hCountries, "CV", "AF");
	SetTrieString(g_hCountries, "CX", "AS");
	SetTrieString(g_hCountries, "CY", "AS");
	SetTrieString(g_hCountries, "CZ", "EU");
	SetTrieString(g_hCountries, "DE", "EU");
	SetTrieString(g_hCountries, "DJ", "AF");
	SetTrieString(g_hCountries, "DK", "EU");
	SetTrieString(g_hCountries, "DM", "NA");
	SetTrieString(g_hCountries, "DO", "NA");
	SetTrieString(g_hCountries, "DZ", "AF");
	SetTrieString(g_hCountries, "EC", "SA");
	SetTrieString(g_hCountries, "EE", "EU");
	SetTrieString(g_hCountries, "EG", "AF");
	SetTrieString(g_hCountries, "EH", "AF");
	SetTrieString(g_hCountries, "ER", "AF");
	SetTrieString(g_hCountries, "ES", "EU");
	SetTrieString(g_hCountries, "ET", "AF");
	SetTrieString(g_hCountries, "EU", "EU");
	SetTrieString(g_hCountries, "FI", "EU");
	SetTrieString(g_hCountries, "FJ", "OC");
	SetTrieString(g_hCountries, "FK", "SA");
	SetTrieString(g_hCountries, "FM", "OC");
	SetTrieString(g_hCountries, "FO", "EU");
	SetTrieString(g_hCountries, "FR", "EU");
	SetTrieString(g_hCountries, "FX", "EU");
	SetTrieString(g_hCountries, "GA", "AF");
	SetTrieString(g_hCountries, "GB", "EU");
	SetTrieString(g_hCountries, "GD", "NA");
	SetTrieString(g_hCountries, "GE", "AS");
	SetTrieString(g_hCountries, "GF", "SA");
	SetTrieString(g_hCountries, "GG", "EU");
	SetTrieString(g_hCountries, "GH", "AF");
	SetTrieString(g_hCountries, "GI", "EU");
	SetTrieString(g_hCountries, "GL", "NA");
	SetTrieString(g_hCountries, "GM", "AF");
	SetTrieString(g_hCountries, "GN", "AF");
	SetTrieString(g_hCountries, "GP", "NA");
	SetTrieString(g_hCountries, "GQ", "AF");
	SetTrieString(g_hCountries, "GR", "EU");
	SetTrieString(g_hCountries, "GS", "AN");
	SetTrieString(g_hCountries, "GT", "NA");
	SetTrieString(g_hCountries, "GU", "OC");
	SetTrieString(g_hCountries, "GW", "AF");
	SetTrieString(g_hCountries, "GY", "SA");
	SetTrieString(g_hCountries, "HK", "AS");
	SetTrieString(g_hCountries, "HM", "AN");
	SetTrieString(g_hCountries, "HN", "NA");
	SetTrieString(g_hCountries, "HR", "EU");
	SetTrieString(g_hCountries, "HT", "NA");
	SetTrieString(g_hCountries, "HU", "EU");
	SetTrieString(g_hCountries, "ID", "AS");
	SetTrieString(g_hCountries, "IE", "EU");
	SetTrieString(g_hCountries, "IL", "AS");
	SetTrieString(g_hCountries, "IM", "EU");
	SetTrieString(g_hCountries, "IN", "AS");
	SetTrieString(g_hCountries, "IO", "AS");
	SetTrieString(g_hCountries, "IQ", "AS");
	SetTrieString(g_hCountries, "IR", "AS");
	SetTrieString(g_hCountries, "IS", "EU");
	SetTrieString(g_hCountries, "IT", "EU");
	SetTrieString(g_hCountries, "JE", "EU");
	SetTrieString(g_hCountries, "JM", "NA");
	SetTrieString(g_hCountries, "JO", "AS");
	SetTrieString(g_hCountries, "JP", "AS");
	SetTrieString(g_hCountries, "KE", "AF");
	SetTrieString(g_hCountries, "KG", "AS");
	SetTrieString(g_hCountries, "KH", "AS");
	SetTrieString(g_hCountries, "KI", "OC");
	SetTrieString(g_hCountries, "KM", "AF");
	SetTrieString(g_hCountries, "KN", "NA");
	SetTrieString(g_hCountries, "KP", "AS");
	SetTrieString(g_hCountries, "KR", "AS");
	SetTrieString(g_hCountries, "KW", "AS");
	SetTrieString(g_hCountries, "KY", "NA");
	SetTrieString(g_hCountries, "KZ", "AS");
	SetTrieString(g_hCountries, "LA", "AS");
	SetTrieString(g_hCountries, "LB", "AS");
	SetTrieString(g_hCountries, "LC", "NA");
	SetTrieString(g_hCountries, "LI", "EU");
	SetTrieString(g_hCountries, "LK", "AS");
	SetTrieString(g_hCountries, "LR", "AF");
	SetTrieString(g_hCountries, "LS", "AF");
	SetTrieString(g_hCountries, "LT", "EU");
	SetTrieString(g_hCountries, "LU", "EU");
	SetTrieString(g_hCountries, "LV", "EU");
	SetTrieString(g_hCountries, "LY", "AF");
	SetTrieString(g_hCountries, "MA", "AF");
	SetTrieString(g_hCountries, "MC", "EU");
	SetTrieString(g_hCountries, "MD", "EU");
	SetTrieString(g_hCountries, "ME", "EU");
	SetTrieString(g_hCountries, "MF", "NA");
	SetTrieString(g_hCountries, "MG", "AF");
	SetTrieString(g_hCountries, "MH", "OC");
	SetTrieString(g_hCountries, "MK", "EU");
	SetTrieString(g_hCountries, "ML", "AF");
	SetTrieString(g_hCountries, "MM", "AS");
	SetTrieString(g_hCountries, "MN", "AS");
	SetTrieString(g_hCountries, "MO", "AS");
	SetTrieString(g_hCountries, "MP", "OC");
	SetTrieString(g_hCountries, "MQ", "NA");
	SetTrieString(g_hCountries, "MR", "AF");
	SetTrieString(g_hCountries, "MS", "NA");
	SetTrieString(g_hCountries, "MT", "EU");
	SetTrieString(g_hCountries, "MU", "AF");
	SetTrieString(g_hCountries, "MV", "AS");
	SetTrieString(g_hCountries, "MW", "AF");
	SetTrieString(g_hCountries, "MX", "NA");
	SetTrieString(g_hCountries, "MY", "AS");
	SetTrieString(g_hCountries, "MZ", "AF");
	SetTrieString(g_hCountries, "NA", "AF");
	SetTrieString(g_hCountries, "NC", "OC");
	SetTrieString(g_hCountries, "NE", "AF");
	SetTrieString(g_hCountries, "NF", "OC");
	SetTrieString(g_hCountries, "NG", "AF");
	SetTrieString(g_hCountries, "NI", "NA");
	SetTrieString(g_hCountries, "NL", "EU");
	SetTrieString(g_hCountries, "NO", "EU");
	SetTrieString(g_hCountries, "NP", "AS");
	SetTrieString(g_hCountries, "NR", "OC");
	SetTrieString(g_hCountries, "NU", "OC");
	SetTrieString(g_hCountries, "NZ", "OC");
	SetTrieString(g_hCountries, "O1", "OC");
	SetTrieString(g_hCountries, "OM", "AS");
	SetTrieString(g_hCountries, "PA", "NA");
	SetTrieString(g_hCountries, "PE", "SA");
	SetTrieString(g_hCountries, "PF", "OC");
	SetTrieString(g_hCountries, "PG", "OC");
	SetTrieString(g_hCountries, "PH", "AS");
	SetTrieString(g_hCountries, "PK", "AS");
	SetTrieString(g_hCountries, "PL", "EU");
	SetTrieString(g_hCountries, "PM", "NA");
	SetTrieString(g_hCountries, "PN", "OC");
	SetTrieString(g_hCountries, "PR", "NA");
	SetTrieString(g_hCountries, "PS", "AS");
	SetTrieString(g_hCountries, "PT", "EU");
	SetTrieString(g_hCountries, "PW", "OC");
	SetTrieString(g_hCountries, "PY", "SA");
	SetTrieString(g_hCountries, "QA", "AS");
	SetTrieString(g_hCountries, "RE", "AF");
	SetTrieString(g_hCountries, "RO", "EU");
	SetTrieString(g_hCountries, "RS", "EU");
	SetTrieString(g_hCountries, "RU", "EU");
	SetTrieString(g_hCountries, "RW", "AF");
	SetTrieString(g_hCountries, "SA", "AS");
	SetTrieString(g_hCountries, "SB", "OC");
	SetTrieString(g_hCountries, "SC", "AF");
	SetTrieString(g_hCountries, "SD", "AF");
	SetTrieString(g_hCountries, "SE", "EU");
	SetTrieString(g_hCountries, "SG", "AS");
	SetTrieString(g_hCountries, "SH", "AF");
	SetTrieString(g_hCountries, "SI", "EU");
	SetTrieString(g_hCountries, "SJ", "EU");
	SetTrieString(g_hCountries, "SK", "EU");
	SetTrieString(g_hCountries, "SL", "AF");
	SetTrieString(g_hCountries, "SM", "EU");
	SetTrieString(g_hCountries, "SN", "AF");
	SetTrieString(g_hCountries, "SO", "AF");
	SetTrieString(g_hCountries, "SR", "SA");
	SetTrieString(g_hCountries, "ST", "AF");
	SetTrieString(g_hCountries, "SV", "NA");
	SetTrieString(g_hCountries, "SY", "AS");
	SetTrieString(g_hCountries, "SZ", "AF");
	SetTrieString(g_hCountries, "TC", "NA");
	SetTrieString(g_hCountries, "TD", "AF");
	SetTrieString(g_hCountries, "TF", "AN");
	SetTrieString(g_hCountries, "TG", "AF");
	SetTrieString(g_hCountries, "TH", "AS");
	SetTrieString(g_hCountries, "TJ", "AS");
	SetTrieString(g_hCountries, "TK", "OC");
	SetTrieString(g_hCountries, "TL", "AS");
	SetTrieString(g_hCountries, "TM", "AS");
	SetTrieString(g_hCountries, "TN", "AF");
	SetTrieString(g_hCountries, "TO", "OC");
	SetTrieString(g_hCountries, "TR", "EU");
	SetTrieString(g_hCountries, "TT", "NA");
	SetTrieString(g_hCountries, "TV", "OC");
	SetTrieString(g_hCountries, "TW", "AS");
	SetTrieString(g_hCountries, "TZ", "AF");
	SetTrieString(g_hCountries, "UA", "EU");
	SetTrieString(g_hCountries, "UG", "AF");
	SetTrieString(g_hCountries, "UM", "OC");
	SetTrieString(g_hCountries, "US", "NA");
	SetTrieString(g_hCountries, "UY", "SA");
	SetTrieString(g_hCountries, "UZ", "AS");
	SetTrieString(g_hCountries, "VA", "EU");
	SetTrieString(g_hCountries, "VC", "NA");
	SetTrieString(g_hCountries, "VE", "SA");
	SetTrieString(g_hCountries, "VG", "NA");
	SetTrieString(g_hCountries, "VI", "NA");
	SetTrieString(g_hCountries, "VN", "AS");
	SetTrieString(g_hCountries, "VU", "OC");
	SetTrieString(g_hCountries, "WF", "OC");
	SetTrieString(g_hCountries, "WS", "OC");
	SetTrieString(g_hCountries, "YE", "AS");
	SetTrieString(g_hCountries, "YT", "AF");
	SetTrieString(g_hCountries, "ZA", "AF");
	SetTrieString(g_hCountries, "ZM", "AF");
	SetTrieString(g_hCountries, "ZW", "AF");
}

stock GeoContinent(client, String:cont[3])
{
	new String:m_szIP[32];
	new String:m_szCountry[3];

	GetClientIP(client, m_szIP, sizeof(m_szIP));
	GeoipCode2(m_szIP, m_szCountry);

	GetTrieString(g_hCountries, m_szCountry, cont, sizeof(cont));
}